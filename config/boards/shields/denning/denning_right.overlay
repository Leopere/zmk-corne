#include "denning.dtsi"
&default_transform {
    col-offset = <7>;
};
/ {
    chosen {
        zmk,kscan = &kscan;
        zmk,matrix-transform = &default_transform;
    };
// ROWS and COLUMNS as wired on the left hand.
// ROW1 = D4, ROW2 = D5, ROW3 = D6, ROW4 = D14
// Col1 = D0, COl2 = D1, COL3 = D2, COL4 = D3, COL5 = D, COL6 = D5, COL7 = D6
    kscan: kscan {
        compatible = "zmk,kscan-gpio-matrix";
        label = "kscan";
        diode-direction = "col2row";

        row-gpios = <&pro_micro 10 (GPIO_ACTIVE_HIGH|GPIO_PULL_DOWN)>,
                    <&pro_micro 9 (GPIO_ACTIVE_HIGH|GPIO_PULL_DOWN)>,
                    <&pro_micro 8 (GPIO_ACTIVE_HIGH|GPIO_PULL_DOWN)>,
                    <&pro_micro 7 (GPIO_ACTIVE_HIGH|GPIO_PULL_DOWN)>;

        col-gpios = <&pro_micro 6 GPIO_ACTIVE_HIGH>,
                    <&pro_micro 5 GPIO_ACTIVE_HIGH>,
                    <&pro_micro 4 GPIO_ACTIVE_HIGH>,
                    <&pro_micro 3 GPIO_ACTIVE_HIGH>,
                    <&pro_micro 2 GPIO_ACTIVE_HIGH>,
                    <&pro_micro 1 GPIO_ACTIVE_HIGH>,
                    <&pro_micro 0 GPIO_ACTIVE_HIGH>;
    };
};