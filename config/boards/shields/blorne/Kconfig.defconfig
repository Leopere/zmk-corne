## config/boards/shields/blorne/Kconfig.defconfig
```kconfig
if SHIELD_BLORNE_LEFT

config ZMK_KEYBOARD_NAME
    default "blorne"

config ZMK_SPLIT_ROLE_CENTRAL
    default y
endif

if SHIELD_BLORNE_LEFT || SHIELD_BLORNE_RIGHT

config ZMK_SPLIT
    default y

config ZMK_BATTERY_REPORTING
    default n
endif
```

## config/boards/shields/blorne/Kconfig.shield
```kconfig
config SHIELD_BLORNE_LEFT
    def_bool $(shields_list_contains,blorne_left)
config SHIELD_BLORNE_RIGHT
    def_bool $(shields_list_contains,blorne_right)
```

## config/boards/shields/corne/Kconfig.defconfig
```kconfig
if SHIELD_CORNE_LEFT

config ZMK_KEYBOARD_NAME
    default "corne"

config ZMK_SPLIT_ROLE_CENTRAL
    default Y
endif

if SHIELD_CORNE_LEFT || SHIELD_CORNE_RIGHT

config ZMK_SPLIT
    default Y

config ZMK_BATTERY_REPORTING
    default n
endif
```

## config/boards/shields/corne/Kconfig.shield
```kconfig
config SHIELD_CORNE_LEFT
    def_bool $(shields_list_contains,corne)
config SHIELD_CORNE_RIGHT
    def_bool $(shields_list_contains,corne)
```

## config/boards/shields/denning/Kconfig.defconfig
```kconfig
if SHIELD_DENNING_LEFT

config ZMK_KEYBOARD_NAME
    default "denning"

config ZMK_SPLIT_ROLE_CENTRAL
    default y
endif

if SHIELD_DENNING_LEFT || SHIELD_DENNING_RIGHT

config ZMK_SPLIT
    default y

config ZMK_BATTERY_REPORTING
    default n
endif
```

## config/boards/shields/denning/Kconfig.shield
```kconfig
config SHIELD_DENNING_LEFT
    def_bool $(shields_list_contains,denning_left)
config SHIELD_DENNING_RIGHT
    def_bool $(shields_list_contains,denning_right)
```
