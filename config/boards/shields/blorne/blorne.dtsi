
#include <dt-bindings/zmk/matrix_transform.h>
/ {
        chosen {
            zmk,keyscan = &kscan;
            zmk,matrix_transform = &default_transform;
        };
        default_transform: keymap_transform_0 {
            compatible = "zmk,matrix-transform";
            columns = <14>;
            rows = <4>;
            bindings = <
            //Row1
                // 0        2           3           4           5           6           7           8         9             10            11         12         13         15
                RC(0,1)     RC(0,2)     RC(0,3)     RC(0,4)     RC(0,5)     RC(0,6)                           RC(0,13)       RC(0,12)       RC(0,11)   RC(0,10)   RC(0,9)   RC(0,8)
            //Row2
                // 13       14          15          16          17          18                                19            20            21         22         23         24
                RC(1,1)     RC(1,2)     RC(1,3)     RC(1,4)     RC(1,5)     RC(1,6)                           RC(1,13)       RC(1,12)       RC(1,11)   RC(1,10)   RC(1,9)   RC(1,8)
            //Row3
                //  25      26          27          28          29          30                                31            32            33         34         35         36
                RC(2,1)     RC(2,2)     RC(2,3)     RC(2,4)     RC(2,5)     RC(2,6)                           RC(2,13)       RC(2,12)       RC(2,11)   RC(2,10)   RC(2,9)   RC(2,8)
            //Row4
                                                                37          38          39          49         50             51
                                                                RC(3,5)     RC(3,6)     RC(3,7)     RC(3,14)   RC(3,13)       RC(3,12)    
            >;
    };
};